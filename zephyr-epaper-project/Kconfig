## zephyr-epaper-project/Kconfig
```kconfig
# E-Paper driver Kconfig
#
# Copyright (c) 2025
# SPDX-License-Identifier: Apache-2.0

menu "E-Paper Display Drivers"

config EPAPER_EPD_2IN9_V2
	bool "Waveshare EPD 2.9\" V2 e-Paper Display Driver"
	depends on SPI
	depends on GPIO
	help
	  Enable driver for Waveshare EPD 2.9" V2 e-Paper display.
	  This display uses SPI interface and requires RST, DC, CS, and BUSY GPIO pins.

if EPAPER_EPD_2IN9_V2

config EPAPER_EPD_2IN9_V2_INIT_PRIORITY
	int "E-Paper display initialization priority"
	default 80
	help
	  Initialization priority for the e-Paper display driver.
	  Must be greater than SPI and GPIO initialization priorities.

config EPAPER_EPD_2IN9_V2_PARTIAL_UPDATE
	bool "Enable partial update support"
	default y
	help
	  Enable partial screen update functionality.
	  This allows updating only a portion of the display.

config EPAPER_EPD_2IN9_V2_FAST_MODE
	bool "Enable fast refresh mode"
	default y
	help
	  Enable fast refresh mode for quicker screen updates.
	  This mode provides faster refresh at the cost of some quality.

config EPAPER_EPD_2IN9_V2_GRAY4_MODE
	bool "Enable 4-level grayscale mode"
	default y
	help
	  Enable 4-level grayscale display mode.
	  This allows displaying images with 4 gray levels instead of just black/white.

endif # EPAPER_EPD_2IN9_V2

endmenu
```

## zephyr-epaper-project/dts/bindings/waveshare,epd-2in9-v2.yaml
```yaml
# Device tree binding for Waveshare EPD 2.9" V2 e-Paper Display
#
# Copyright (c) 2025
# SPDX-License-Identifier: Apache-2.0

description: Waveshare EPD 2.9 inch V2 e-Paper Display

compatible: "waveshare,epd-2in9-v2"

include: spi-device.yaml

properties:
  rst-gpios:
    type: phandle-array
    required: true
    description: Reset GPIO pin

  dc-gpios:
    type: phandle-array
    required: true
    description: Data/Command selection GPIO pin

  busy-gpios:
    type: phandle-array
    required: true
    description: Busy status GPIO pin

  width:
    type: int
    default: 128
    description: Display width in pixels

  height:
    type: int
    default: 296
    description: Display height in pixels
```

## zephyr-epaper-project/lib/lvgl/Kconfig
```kconfig
# LVGL Library Configuration
#
# Copyright (c) 2025
# SPDX-License-Identifier: Apache-2.0

menuconfig LVGL
	bool "LVGL - Light and Versatile Graphics Library"
	help
	  Enable LVGL graphics library support.
	  This is a manual integration of the latest LVGL library.

if LVGL

config LVGL_COLOR_DEPTH
	int "Color depth (bits per pixel)"
	default 1
	help
	  Color depth for LVGL. For e-Paper displays, use 1-bit.

config LVGL_DPI
	int "Dots per inch"
	default 128
	help
	  Dots per inch of the display.

config LVGL_HOR_RES
	int "Horizontal resolution"
	default 128
	help
	  Horizontal resolution of the display.

config LVGL_VER_RES
	int "Vertical resolution"
	default 296
	help
	  Vertical resolution of the display.

config LVGL_DISPLAY_BUFFER_SIZE
	int "Display buffer size in pixels"
	default 4736
	help
	  Size of the LVGL display buffer in pixels.
	  For 128x296 e-Paper: (128 * 296) / 8 = 4736 bytes

endif # LVGL
```
